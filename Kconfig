## Kconfig
```kconfig
config ALIOTH_PERF
    bool "Alioth Ultra Performance Tweaks"
    default y
    help
      Enable Alioth Ultra Performance scheduler tweaks for maximum
      UI smoothness on SM8250 platform. Includes input boost,
      CPU/GPU/RAM boost, VSync/FSync control, and frame boost.

      This driver is compatible with Franco Kernel Manager and
      provides sysfs interfaces for tuning.

config ALIOTH_RAM
    bool "Alioth Adaptive RAM Optimization"
    default y
    help
      Enable adaptive RAM optimization for Alioth devices.
      Automatically tunes swappiness, zRAM, and memory reclaim
      based on total RAM size and current workload.
      Compatible with all custom ROMs.

config ALIOTH_GPU
    bool "Alioth GPU Boost & Control"
    default y
    help
      Enable GPU boost and control module for Alioth devices.
      Provides sysfs interfaces for GPU frequency control,
      boost settings, governor selection, and preemption tuning.
      Compatible with Franco Kernel Manager GPU tunables.

config ALIOTH_CPU
    bool "Alioth CPU Frequency & Governor Control"
    default y
    help
      Enable CPU frequency and governor control module for Alioth.
      Provides sysfs interfaces for per-cluster governor selection,
      min/max frequency control, boost settings, and governor tunables.
      Compatible with Franco Kernel Manager CPU tunables.
```

## alioth_addons_defconfig
```kconfig
#
# Alioth Ultra Custom Modules
#

# Performance Drivers
CONFIG_ALIOTH_PERF=y
CONFIG_ALIOTH_RAM=y
CONFIG_ALIOTH_GPU=y
CONFIG_ALIOTH_CPU=y

# Root Managers
CONFIG_KSU=y
CONFIG_KSU_DEBUG=y
CONFIG_KSU_ALLOWLIST_WORKAROUND=y
CONFIG_SUKISU=y
CONFIG_SUKISU_KPM=y
CONFIG_KPM=y
CONFIG_SUSFS=y
CONFIG_SUSFS_SUS_SU=y
CONFIG_SUSFS_AUTO_ADD_SUS_KSU_DEFAULT_MOUNT=y
CONFIG_SUSFS_AUTO_ADD_TRY_SUS_MOUNT_BIND=y

# VSync/FSync Control
CONFIG_DYNAMIC_FSYNC=y
CONFIG_FSYNC_CONTROL=y
CONFIG_VSYNC_CONTROL=y
CONFIG_DYNAMIC_VSYNC=y
CONFIG_VSYNC_DISABLE=y

# Performance Features
CONFIG_CPU_BOOST=y
CONFIG_CPU_INPUT_BOOST=y
CONFIG_GPU_BOOST=y
CONFIG_GPU_INPUT_BOOST=y
CONFIG_IO_BOOST=y
CONFIG_INPUT_BOOST=y

# Memory
CONFIG_ZRAM_MULTI_COMP=y
CONFIG_ZRAM_DEF_COMP_LZ4=y
CONFIG_ZRAM_DEF_COMP_LZ4HC=y
CONFIG_ZRAM_DEF_COMP_ZSTD=y
CONFIG_LRU_GEN=y
CONFIG_LRU_GEN_ENABLED=y

# I/O
CONFIG_DEFAULT_BFQ=y
CONFIG_BFQ_GROUP_IOSCHED=y

# Networking
CONFIG_TCP_CONG_BBR=y
CONFIG_TCP_CONG_BBR2=y
CONFIG_DEFAULT_BBR=y
CONFIG_MPTCP=y
CONFIG_MPTCP_IPV6=y
CONFIG_WIREGUARD=y

# Security (allow toggling)
CONFIG_SECURITY_SELINUX_BOOTPARAM=y
CONFIG_SECURITY_SELINUX_BOOTPARAM_VALUE=0
CONFIG_SECURITY_SELINUX_DISABLE=y

# Disable debug overhead
CONFIG_DEBUG_KERNEL=n
CONFIG_DEBUG_FS=n
CONFIG_DYNAMIC_DEBUG=n
```
