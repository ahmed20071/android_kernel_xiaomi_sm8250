## alioth_perf_defconfig
```kconfig
#
# Alioth (POCO F3) Ultra Performance Kernel Config
# Based on SM8250 platform - Optimized for Android 16 / HyperOS 3 / AOSP
# Target: Maximum UI Smoothness & Performance
#

CONFIG_LOCALVERSION="-Alioth-Ultra-v1.0"
CONFIG_LOCALVERSION_AUTO=n

#========================================
# Platform Configuration
#========================================
CONFIG_ARCH_QCOM=y
CONFIG_ARCH_SM8250=y
CONFIG_ARCH_KONA=y
CONFIG_ARCH_KONA_V2=y
CONFIG_ARCH_KONA_V2_1=y
CONFIG_ARCH_QCOM_V2=y
CONFIG_ARCH_QCOM_V2_1=y

#========================================
# CPU Configuration - Maximum Performance
#========================================
CONFIG_NR_CPUS=8
CONFIG_SCHED_MC=y
CONFIG_SCHED_SMT=y
CONFIG_SCHED_CLUSTER=y

# CPU Governors - Performance focused
CONFIG_CPU_FREQ=y
CONFIG_CPU_FREQ_DEFAULT_GOV_PERFORMANCE=y
CONFIG_CPU_FREQ_GOV_PERFORMANCE=y
CONFIG_CPU_FREQ_GOV_POWERSAVE=y
CONFIG_CPU_FREQ_GOV_USERSPACE=y
CONFIG_CPU_FREQ_GOV_ONDEMAND=y
CONFIG_CPU_FREQ_GOV_CONSERVATIVE=y
CONFIG_CPU_FREQ_GOV_INTERACTIVE=y
CONFIG_CPU_FREQ_GOV_SCHEDUTIL=y

# CPU Boost
CONFIG_CPU_BOOST=y
CONFIG_CPU_INPUT_BOOST=y
CONFIG_CPU_INPUT_BOOST_DURATION_MS=100
CONFIG_CPU_INPUT_BOOST_FREQ_LITTLE=1804800
CONFIG_CPU_INPUT_BOOST_FREQ_BIG=2208000
CONFIG_CPU_INPUT_BOOST_FREQ_PRIME=2419200

# CPUFreq drivers
CONFIG_CPUFREQ_DT=y
CONFIG_ARM_QCOM_CPUFREQ_HW=y
CONFIG_ARM_QCOM_CPUFREQ_HW_DEBUG=y
CONFIG_ARM_QCOM_CPUFREQ_NVMEM=y

# Thermal - Aggressive but safe
CONFIG_THERMAL=y
CONFIG_THERMAL_GOV_STEP_WISE=y
CONFIG_THERMAL_GOV_FAIR_SHARE=y
CONFIG_THERMAL_GOV_USER_SPACE=y
CONFIG_THERMAL_GOV_POWER_ALLOCATOR=y
CONFIG_THERMAL_EMULATION=y
CONFIG_QCOM_THERMAL=y
CONFIG_QCOM_SPMI_TEMP_ALARM=y
CONFIG_QCOM_BCL_PMIC5=y
CONFIG_QCOM_BCL_SOC_DRIVER=y

#========================================
# GPU Configuration - Maximum Performance
#========================================
CONFIG_QCOM_KGSL=y
CONFIG_QCOM_KGSL_CORE=y
CONFIG_QCOM_KGSL_CONTEXT=y
CONFIG_QCOM_KGSL_IOMMU=y
CONFIG_QCOM_KGSL_PER_PROCESS_PAGE_TABLE=y
CONFIG_QCOM_KGSL_IOCOHERENCY=y
CONFIG_QCOM_KGSL_SNAPSHOT=y
CONFIG_QCOM_KGSL_SNAPSHOT_LOG=y
CONFIG_QCOM_KGSL_SNAPSHOT_MINI_DUMP=y
CONFIG_QCOM_KGSL_SNAPSHOT_CRASH_DUMPER=y
CONFIG_QCOM_KGSL_SNAPSHOT_FORCE_PANIC=y

# GPU Boost
CONFIG_GPU_BOOST=y
CONFIG_GPU_INPUT_BOOST=y
CONFIG_GPU_INPUT_BOOST_FREQ=800000000
CONFIG_GPU_INPUT_BOOST_DURATION_MS=100

# DRM/Display
CONFIG_DRM=y
CONFIG_DRM_MSM=y
CONFIG_DRM_MSM_DPU=y
CONFIG_DRM_MSM_DP=y
CONFIG_DRM_MSM_DSI=y
CONFIG_DRM_MSM_DSI_28NM_PHY=y
CONFIG_DRM_MSM_DSI_20NM_PHY=y
CONFIG_DRM_MSM_DSI_10NM_PHY=y
CONFIG_DRM_MSM_DSI_7NM_PHY=y
CONFIG_DRM_MSM_DSI_7NM_PHY_V2=y
CONFIG_DRM_MSM_DSI_7NM_PHY_V3=y
CONFIG_DRM_MSM_DSI_7NM_PHY_V4=y

#========================================
# Memory Management - Ultra Optimized
#========================================
CONFIG_ZSMALLOC=y
CONFIG_ZSMALLOC_STAT=y
CONFIG_ZBUD=y
CONFIG_ZSWAP=y
CONFIG_ZSWAP_COMPRESSOR_DEFAULT=lz4
CONFIG_ZSWAP_ZPOOL_DEFAULT=zsmalloc
CONFIG_ZBUD=y

# zRAM with multiple algorithms
CONFIG_ZRAM=y
CONFIG_ZRAM_WRITEBACK=y
CONFIG_ZRAM_MEMORY_TRACKING=y
CONFIG_ZRAM_MULTI_COMP=y
CONFIG_ZRAM_DEF_COMP_LZ4=y
CONFIG_ZRAM_DEF_COMP_LZ4HC=y
CONFIG_ZRAM_DEF_COMP_ZSTD=y

# Memory reclaim
CONFIG_LRU_GEN=y
CONFIG_LRU_GEN_ENABLED=y

# Swappiness
CONFIG_VM_SWAPPINESS=60

# KSM
CONFIG_KSM=y
CONFIG_UKSM=y

#========================================
# I/O & Block - Maximum Performance
#========================================
CONFIG_IOSCHED_NOOP=y
CONFIG_IOSCHED_DEADLINE=y
CONFIG_IOSCHED_CFQ=y
CONFIG_IOSCHED_BFQ=y
CONFIG_CFQ_GROUP_IOSCHED=y
CONFIG_BFQ_GROUP_IOSCHED=y
CONFIG_DEFAULT_BFQ=y
CONFIG_DEFAULT_IOSCHED="bfq"

# I/O Boost
CONFIG_IO_BOOST=y

# F2FS
CONFIG_F2FS_FS=y
CONFIG_F2FS_STAT_FS=y
CONFIG_F2FS_FS_XATTR=y
CONFIG_F2FS_FS_POSIX_ACL=y
CONFIG_F2FS_FS_SECURITY=y
CONFIG_F2FS_CHECK_FS=y
CONFIG_F2FS_FAULT_INJECTION=y
CONFIG_F2FS_FS_COMPRESSION=y
CONFIG_F2FS_FS_LZ4=y
CONFIG_F2FS_FS_LZ4HC=y
CONFIG_F2FS_FS_ZSTD=y
CONFIG_F2FS_IOSTAT=y
CONFIG_F2FS_UNFAIR_RWSEM=y

# EROFS
CONFIG_EROFS_FS=y
CONFIG_EROFS_FS_ZIP=y
CONFIG_EROFS_FS_ZIP_LZMA=y
CONFIG_EROFS_FS_PCPU_KTHREAD=y

# exFAT
CONFIG_EXFAT_FS=y

# NTFS
CONFIG_NTFS_FS=y
CONFIG_NTFS_RW=y

#========================================
# Input & Touchscreen - Ultra Responsive
#========================================
CONFIG_INPUT=y
CONFIG_INPUT_EVDEV=y
CONFIG_INPUT_TOUCHSCREEN=y
CONFIG_INPUT_MISC=y

# Input Boost
CONFIG_INPUT_BOOST=y
CONFIG_INPUT_BOOST_DURATION_MS=50
CONFIG_INPUT_BOOST_CPU_FREQ_LITTLE=1804800
CONFIG_INPUT_BOOST_CPU_FREQ_BIG=2208000
CONFIG_INPUT_BOOST_CPU_FREQ_PRIME=2419200

#========================================
# VSync & FSync Control
#========================================
CONFIG_SW_SYNC=y
CONFIG_SYNC_FILE=y
CONFIG_SYNC_DEBUG=y

# FSync toggle support
CONFIG_DYNAMIC_FSYNC=y
CONFIG_FSYNC_CONTROL=y

# VSync control
CONFIG_VSYNC_CONTROL=y
CONFIG_DYNAMIC_VSYNC=y
CONFIG_VSYNC_DISABLE=y

#========================================
# Scheduler - Ultra Performance
#========================================
CONFIG_SCHED_AUTOGROUP=y
CONFIG_SCHED_TUNE=y
CONFIG_SCHED_CORE=y
CONFIG_SCHED_SMT=y
CONFIG_SCHED_CLUSTER=y

# UCLAMP
CONFIG_UCLAMP_TASK=y
CONFIG_UCLAMP_BUCKETS_COUNT=20

# Energy Model
CONFIG_ENERGY_MODEL=y

#========================================
# Networking - Maximum Performance
#========================================
CONFIG_NET=y
CONFIG_INET=y
CONFIG_IPV6=y
CONFIG_TCP_CONG_ADVANCED=y
CONFIG_TCP_CONG_BIC=y
CONFIG_TCP_CONG_CUBIC=y
CONFIG_TCP_CONG_WESTWOOD=y
CONFIG_TCP_CONG_HTCP=y
CONFIG_TCP_CONG_HSTCP=y
CONFIG_TCP_CONG_HYBLA=y
CONFIG_TCP_CONG_VEGAS=y
CONFIG_TCP_CONG_NV=y
CONFIG_TCP_CONG_SCALABLE=y
CONFIG_TCP_CONG_LP=y
CONFIG_TCP_CONG_VENO=y
CONFIG_TCP_CONG_YEAH=y
CONFIG_TCP_CONG_ILLINOIS=y
CONFIG_TCP_CONG_DCTCP=y
CONFIG_TCP_CONG_CDG=y
CONFIG_TCP_CONG_BBR=y
CONFIG_TCP_CONG_BBR2=y
CONFIG_DEFAULT_BBR=y
CONFIG_DEFAULT_TCP_CONG="bbr"

# WiFi
CONFIG_CFG80211=y
CONFIG_CFG80211_CERTIFICATION_ONUS=y
CONFIG_CFG80211_DEBUGFS=y
CONFIG_CFG80211_WEXT=y
CONFIG_MAC80211=y
CONFIG_MAC80211_HAS_RC=y
CONFIG_MAC80211_RC_MINSTREL=y
CONFIG_MAC80211_RC_MINSTREL_HT=y
CONFIG_MAC80211_RC_MINSTREL_VHT=y
CONFIG_MAC80211_RC_DEFAULT_MINSTREL=y
CONFIG_MAC80211_RC_DEFAULT="minstrel_ht"

#========================================
# Root Managers Support
#========================================
# KernelSU
CONFIG_KSU=y
CONFIG_KSU_DEBUG=y
CONFIG_KSU_ALLOWLIST_WORKAROUND=y

# SukiSU Ultra / ReSukiSU
CONFIG_SUKISU=y
CONFIG_SUKISU_KPM=y
CONFIG_KPM=y

# Magisk (via KernelSU compatibility)
CONFIG_KSU_MAGISK=y

# SuSFS support
CONFIG_SUSFS=y
CONFIG_SUSFS_SUS_SU=y
CONFIG_SUSFS_AUTO_ADD_SUS_KSU_DEFAULT_MOUNT=y
CONFIG_SUSFS_AUTO_ADD_TRY_SUS_MOUNT_BIND=y

# KALLSYMS (required for root managers)
CONFIG_KALLSYMS=y
CONFIG_KALLSYMS_ALL=y
CONFIG_KALLSYMS_ABSOLUTE_PERCPU=y
CONFIG_KALLSYMS_BASE_RELATIVE=y

#========================================
# BPF - Android 16 Compatible
#========================================
CONFIG_BPF=y
CONFIG_BPF_SYSCALL=y
CONFIG_BPF_JIT=y
CONFIG_BPF_JIT_ALWAYS_ON=y
CONFIG_HAVE_EBPF_JIT=y
CONFIG_BPF_EVENTS=y
CONFIG_BPF_STREAM_PARSER=y
CONFIG_NETFILTER_XT_MATCH_BPF=y
CONFIG_NET_CLS_BPF=y
CONFIG_NET_ACT_BPF=y
CONFIG_BPF_LSM=y
CONFIG_BPF_LIRC_MODE2=y

#========================================
# Security (Minimal for performance)
#========================================
CONFIG_SECURITY=y
CONFIG_SECURITY_SELINUX=y
CONFIG_SECURITY_SELINUX_DEVELOP=y
CONFIG_SECURITY_SELINUX_AVC_STATS=y
CONFIG_SECURITY_SELINUX_CHECKREQPROT_VALUE=0
CONFIG_SECURITY_SELINUX_SIDTAB_HASH_BITS=9
CONFIG_SECURITY_SELINUX_SID2STR_CACHE_SIZE=256

# Disable SELinux enforcing for performance (user can toggle)
CONFIG_SECURITY_SELINUX_BOOTPARAM=y
CONFIG_SECURITY_SELINUX_BOOTPARAM_VALUE=0
CONFIG_SECURITY_SELINUX_DISABLE=y

#========================================
# Debugging (Minimal for performance)
#========================================
# Disable debug to reduce overhead
CONFIG_DEBUG_KERNEL=n
CONFIG_DEBUG_FS=n
CONFIG_DYNAMIC_DEBUG=n
CONFIG_DEBUG_BUGVERBOSE=n
CONFIG_DEBUG_LIST=n
CONFIG_DEBUG_SPINLOCK=n
CONFIG_DEBUG_MUTEXES=n
CONFIG_DEBUG_ATOMIC_SLEEP=n
CONFIG_DEBUG_STACK_USAGE=n
CONFIG_DEBUG_MEMORY=n
CONFIG_DEBUG_KMEMLEAK=n
CONFIG_DEBUG_SHIRQ=n
CONFIG_DEBUG_LOCKING_API_SELFTESTS=n
CONFIG_DEBUG_LOCK_ALLOC=n
CONFIG_PROVE_LOCKING=n
CONFIG_LOCK_STAT=n
CONFIG_DEBUG_LOCKDEP=n

# Enable minimal debug
CONFIG_PRINTK=y
CONFIG_PRINTK_TIME=y
CONFIG_CONSOLE_TRANSLATIONS=y
CONFIG_MESSAGE_LOGLEVEL_DEFAULT=4
CONFIG_CONSOLE_LOGLEVEL_DEFAULT=4
CONFIG_CONSOLE_LOGLEVEL_QUIET=1

#========================================
# Power Management
#========================================
CONFIG_PM=y
CONFIG_PM_SLEEP=y
CONFIG_PM_SLEEP_SMP=y
CONFIG_PM_AUTOSLEEP=y
CONFIG_PM_WAKELOCKS=y
CONFIG_PM_WAKELOCKS_GC=y
CONFIG_PM_RUNTIME=y
CONFIG_PM_GENERIC_DOMAINS=y
CONFIG_WQ_POWER_EFFICIENT_DEFAULT=y

# CPU Idle
CONFIG_CPU_IDLE=y
CONFIG_CPU_IDLE_GOV_LADDER=y
CONFIG_CPU_IDLE_GOV_MENU=y
CONFIG_CPU_IDLE_GOV_TEO=y
CONFIG_CPU_IDLE_GOV_HALTPOLL=y
CONFIG_CPU_IDLE_MULTIPLE_DRIVERS=y
CONFIG_CPU_IDLE_GOV_TEO=y

#========================================
# File Systems
#========================================
CONFIG_EXT4_FS=y
CONFIG_EXT4_FS_POSIX_ACL=y
CONFIG_EXT4_FS_SECURITY=y
CONFIG_EXT4_USE_FOR_EXT2=y
CONFIG_EXT4_FS_ENCRYPTION=y
CONFIG_EXT4_FS_ICE_ENCRYPTION=y

#========================================
# USB & Fast Charge
#========================================
CONFIG_USB=y
CONFIG_USB_SUPPORT=y
CONFIG_USB_ANNOUNCE_NEW_DEVICES=y
CONFIG_USB_MON=y
CONFIG_USB_EHCI_HCD=y
CONFIG_USB_XHCI_HCD=y
CONFIG_USB_STORAGE=y
CONFIG_USB_UAS=y
CONFIG_USB_SERIAL=y
CONFIG_USB_SERIAL_GENERIC=y
CONFIG_USB_SERIAL_CH341=y
CONFIG_USB_SERIAL_CP210X=y
CONFIG_USB_SERIAL_FTDI_SIO=y
CONFIG_USB_SERIAL_PL2303=y
CONFIG_USB_SERIAL_TI=y
CONFIG_USB_SERIAL_QUALCOMM=y

# Fast Charge
CONFIG_FORCE_FAST_CHARGE=y
CONFIG_QCOM_QNOVO=y
CONFIG_QCOM_SMB5=y
CONFIG_QCOM_SMB1398=y

#========================================
# Sound & Audio
#========================================
CONFIG_SOUND=y
CONFIG_SND=y
CONFIG_SND_TIMER=y
CONFIG_SND_PCM=y
CONFIG_SND_JACK=y
CONFIG_SND_JACK_INPUT_DEV=y
CONFIG_SND_DMAENGINE_PCM=y
CONFIG_SND_SOC=y
CONFIG_SND_SOC_GENERIC_DMAENGINE_PCM=y
CONFIG_SND_SOC_QCOM=y
CONFIG_SND_SOC_SM8250=y
CONFIG_SND_SOC_WCD934X=y
CONFIG_SND_SOC_WCD937X=y
CONFIG_SND_SOC_CS35L41=y

#========================================
# Camera
#========================================
CONFIG_VIDEO_V4L2=y
CONFIG_VIDEO_V4L2_SUBDEV_API=y
CONFIG_MEDIA_CONTROLLER=y
CONFIG_V4L2_FWNODE=y
CONFIG_VIDEO_QCOM_CAMSS=y

#========================================
# Sensors
#========================================
CONFIG_SENSORS=y
CONFIG_SENSORS_SSC=y
CONFIG_IIO=y
CONFIG_IIO_BUFFER=y
CONFIG_IIO_KFIFO_BUF=y
CONFIG_IIO_TRIGGER=y
CONFIG_IIO_CONSUMERS_PER_TRIGGER=2

#========================================
# Hardware Random Number Generator
#========================================
CONFIG_HW_RANDOM=y
CONFIG_HW_RANDOM_MSM=y

#========================================
# Crypto - Hardware Accelerated
#========================================
CONFIG_CRYPTO=y
CONFIG_CRYPTO_ALGAPI=y
CONFIG_CRYPTO_ALGAPI2=y
CONFIG_CRYPTO_AEAD=y
CONFIG_CRYPTO_AEAD2=y
CONFIG_CRYPTO_BLKCIPHER=y
CONFIG_CRYPTO_BLKCIPHER2=y
CONFIG_CRYPTO_HASH=y
CONFIG_CRYPTO_HASH2=y
CONFIG_CRYPTO_RNG=y
CONFIG_CRYPTO_RNG2=y
CONFIG_CRYPTO_PCOMP=y
CONFIG_CRYPTO_PCOMP2=y
CONFIG_CRYPTO_ACOMP=y

# Hardware crypto
CONFIG_CRYPTO_DEV_QCOM_RNG=y
CONFIG_CRYPTO_DEV_QCOM_ICE=y

#========================================
# Virtualization
#========================================
CONFIG_KVM=y
CONFIG_KVM_ARM_HOST=y
CONFIG_KVM_ARM_PMU=y
CONFIG_KVM_INDIRECT_VECTORS=y

#========================================
# Android Specific
#========================================
CONFIG_ANDROID=y
CONFIG_ANDROID_BINDER_IPC=y
CONFIG_ANDROID_BINDERFS=y
CONFIG_ANDROID_BINDER_DEVICES="binder,hwbinder,vndbinder"
CONFIG_ANDROID_BINDER_IPC_SELFTEST=y

# Android Low Memory Killer
CONFIG_ANDROID_LOW_MEMORY_KILLER=y
CONFIG_ANDROID_LOW_MEMORY_KILLER_AUTODETECT_OOM_ADJ_VALUES=y

#========================================
# Franco Kernel Manager Compatibility
#========================================
CONFIG_CPU_FREQ_STAT=y
CONFIG_CPU_FREQ_STAT_DETAILS=y
CONFIG_CPU_FREQ_TIMES=y
CONFIG_CPU_FREQ_DEFAULT_GOV_SCHEDUTIL=y

# Thermal zones readable
CONFIG_THERMAL_HWMON=y
CONFIG_THERMAL_WRITABLE_TRIPS=y

# GPU frequency readable
CONFIG_DEVFREQ_GOV_SIMPLE_ONDEMAND=y
CONFIG_DEVFREQ_GOV_PERFORMANCE=y
CONFIG_DEVFREQ_GOV_POWERSAVE=y
CONFIG_DEVFREQ_GOV_USERSPACE=y
CONFIG_DEVFREQ_GOV_PASSIVE=y
CONFIG_DEVFREQ_GOV_CPUFREQ=y

# Voltage control
CONFIG_REGULATOR_DEBUG=y
CONFIG_REGULATOR_FIXED_VOLTAGE=y
CONFIG_REGULATOR_VIRTUAL=y

#========================================
# Performance Tweaks
#========================================
# Disable RCU stall warnings
CONFIG_RCU_STALL_COMMON=y
CONFIG_RCU_CPU_STALL_TIMEOUT=60

# Optimize RCU
CONFIG_RCU_EXPERT=y
CONFIG_RCU_FANOUT=64
CONFIG_RCU_FANOUT_LEAF=16
CONFIG_RCU_FAST_NO_HZ=y

# Workqueues
CONFIG_WQ_POWER_EFFICIENT_DEFAULT=y

# Timer
CONFIG_HZ_300=y
CONFIG_HZ=300

# Preemption
CONFIG_PREEMPT=y
CONFIG_PREEMPT_COUNT=y
CONFIG_PREEMPTION=y

#========================================
# Additional Features
#========================================
# WireGuard
CONFIG_WIREGUARD=y

# BBR2
CONFIG_TCP_CONG_BBR2=y

# MultiPath TCP
CONFIG_MPTCP=y
CONFIG_MPTCP_IPV6=y

# DAMON
CONFIG_DAMON=y
CONFIG_DAMON_VADDR=y
CONFIG_DAMON_PADDR=y
CONFIG_DAMON_SYSFS=y
CONFIG_DAMON_DBGFS=y
CONFIG_DAMON_RECLAIM=y
CONFIG_DAMON_LRU_SORT=y

# USB OTG
CONFIG_USB_OTG=y
CONFIG_USB_OTG_FSM=y
CONFIG_USB_OTG_WHITELIST=y

# LED
CONFIG_LEDS_CLASS=y
CONFIG_LEDS_TRIGGERS=y
CONFIG_LEDS_TRIGGER_TIMER=y
CONFIG_LEDS_TRIGGER_ONESHOT=y
CONFIG_LEDS_TRIGGER_HEARTBEAT=y
CONFIG_LEDS_TRIGGER_BACKLIGHT=y
CONFIG_LEDS_TRIGGER_CPU=y
CONFIG_LEDS_TRIGGER_DEFAULT_ON=y
CONFIG_LEDS_TRIGGER_TRANSIENT=y
CONFIG_LEDS_TRIGGER_CAMERA=y
CONFIG_LEDS_TRIGGER_PANIC=y

# Vibration
CONFIG_INPUT_VIBRATOR=y
CONFIG_INPUT_VIBRATOR_TLV=y

#========================================
# End of Alioth Ultra Performance Config
#========================================
```
